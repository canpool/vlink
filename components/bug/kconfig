## components/bug/kconfig
```kconfig
# Copyright (c) [2021] vlink Team. All rights reserved.
# SPDX-License-Identifier: MulanPSL-2.0

config DEBUG
    bool "enable debug information"
    select UPRINTF
    default y
```

## components/driver/hal/kconfig
```kconfig
# Copyright (c) [2021] vlink Team. All rights reserved.
# SPDX-License-Identifier: MulanPSL-2.0

menu "hardware abstraction layer (hal) configuration"

config HAL
    bool "HAL abstraction layer"
    default n

endmenu
```

## components/driver/kconfig
```kconfig
# Copyright (c) [2021] vlink Team. All rights reserved.
# SPDX-License-Identifier: MulanPSL-2.0

menu "driver configuration"

rsource "*/kconfig"

endmenu
```

## components/fs/kconfig
```kconfig
# Copyright (c) [2021] vlink Team. All rights reserved.
# SPDX-License-Identifier: MulanPSL-2.0

menu "fs configuration"

config VFS
    bool "enable vfs"
    default n

config MOCKFS
    def_bool n
    select VFS

config OPEN_MAX
    int "Maximum number of files that one process can have open at anyone time"
    depends on VFS
    default 16

endmenu
```

## components/kconfig
```kconfig
# Copyright (c) [2021] vlink Team. All rights reserved.
# SPDX-License-Identifier: MulanPSL-2.0

menu "components configuration"

rsource "*/kconfig"

endmenu
```

## components/log/kconfig
```kconfig
# Copyright (c) [2021] vlink Team. All rights reserved.
# SPDX-License-Identifier: MulanPSL-2.0

menu "log configuration"

config VLOG
    bool "vlog system"
    default n

endmenu
```

## components/security/crc/kconfig
```kconfig
# Copyright (c) [2021] vlink Team. All rights reserved.
# SPDX-License-Identifier: MulanPSL-2.0

menu "crc configuration"

config CRC
    def_bool n

config CRC8
    bool "enable CRC 8"
    select CRC
    default n

config CRC16
    bool "enable CRC 16"
    select CRC
    default n

config CRC_CCITT
    bool "enable CRC CCITT"
    select CRC
    default n

config CRC32
    bool "enable CRC 32"
    select CRC
    default n

config CRC64
    bool "enable CRC 64"
    select CRC
    default n

endmenu
```

## components/security/kconfig
```kconfig
# Copyright (c) [2021] vlink Team. All rights reserved.
# SPDX-License-Identifier: MulanPSL-2.0

menu "security configuration"

config SECUREC
    bool "secure C library"
    default n

rsource "crc/kconfig"

endmenu
```

## components/shell/kconfig
```kconfig
# Copyright (c) [2021] vlink Team. All rights reserved.
# SPDX-License-Identifier: MulanPSL-2.0

menu "shell configuration"

config VSH
    bool "vsh shell"
    default n

config VSH_BUF_SIZE
    int "the vsh input buffer size"
    depends on VSH
    default 128

config VSH_NR_ARGS
    int "the vsh number of arguments"
    depends on VSH
    default 8

config VSH_PROMPT
    string "the vsh prompt"
    depends on VSH
    default "vsh"

config VSH_WELLCOME
    string "the vsh wellcome"
    depends on VSH
    default "vlink"

endmenu
```

## components/uprintf/kconfig
```kconfig
# Copyright (c) [2021] vlink Team. All rights reserved.
# SPDX-License-Identifier: MulanPSL-2.0

menu "uprintf configuration"

config UPRINTF
    bool "add uprintf"
    default y

endmenu
```

## kconfig
```kconfig
# Copyright (c) [2020] vlink Team. All rights reserved.
# SPDX-License-Identifier: MulanPSL-2.0

mainmenu "vlink configuration"

rsource "platform/arch/kconfig"
rsource "platform/os/kconfig"
rsource "utils/kconfig"
rsource "components/kconfig"
rsource "tests/kconfig"
```

## platform/arch/kconfig
```kconfig
# Copyright (c) [2020] vlink Team. All rights reserved.
# SPDX-License-Identifier: MulanPSL-2.0

### all hiden, selected by BSP

menu "arch configuration"

rsource "*/kconfig"

# tool configurations

# GNUC is supported by default
config GNUC
    def_bool y

endmenu
```

## platform/arch/varch/kconfig
```kconfig
# Copyright (c) [2020] vlink Team. All rights reserved.
# SPDX-License-Identifier: MulanPSL-2.0

config VARCH
    def_bool n

config ARCH
    string
    default "varch" if VARCH

config ARCH_BITS
    string
    default "32" if VARCH_32
    default "64" if VARCH_32

config VARCH_32
    def_bool n
    select VARCH

config VARCH_64
    def_bool n
    select VARCH
```

## platform/board/vlinux/kconfig
```kconfig
# Copyright (c) [2020] vlink Team. All rights reserved.
# SPDX-License-Identifier: MulanPSL-2.0

config VLINUX
    def_bool n
    select VM

config SOC
    def_string "vm"
```

## platform/board/vlinux32/kconfig
```kconfig
# Copyright (c) [2020] vlink Team. All rights reserved.
# SPDX-License-Identifier: MulanPSL-2.0

config VLINUX32
    def_bool n
    select VM32

config SOC
    def_string "vm32"
```

## platform/board/vlinux64/kconfig
```kconfig
# Copyright (c) [2020] vlink Team. All rights reserved.
# SPDX-License-Identifier: MulanPSL-2.0

config VLINUX64
    def_bool n
    select VM64

config SOC
    def_string "vm64"
```

## platform/os/common/kconfig
```kconfig
# Copyright (c) [2020] vlink Team. All rights reserved.
# SPDX-License-Identifier: MulanPSL-2.0

menu "common configuration"

config SWQUE
    bool "software queue"
    default n

config SWTMR
    bool "software timer"
    default n

endmenu
```

## platform/service/kconfig
```kconfig
# Copyright (c) [2020] vlink Team. All rights reserved.
# SPDX-License-Identifier: MulanPSL-2.0

menu "service configuration"

config VMODULE
    bool "enable module"
    default y

endmenu
```

## platform/soc/vm/kconfig
```kconfig
# Copyright (c) [2020] vlink Team. All rights reserved.
# SPDX-License-Identifier: MulanPSL-2.0

# virtual machine
config VM
    def_bool n
    select VARCH
```

## platform/soc/vm/vm32/kconfig
```kconfig
# Copyright (c) [2020] vlink Team. All rights reserved.
# SPDX-License-Identifier: MulanPSL-2.0

# virtual machine 32bit
config VM32
    def_bool n
    select VARCH_32
    select VM
```

## platform/soc/vm/vm64/kconfig
```kconfig
# Copyright (c) [2020] vlink Team. All rights reserved.
# SPDX-License-Identifier: MulanPSL-2.0

# virtual machine 64bit
config VM64
    def_bool n
    select VARCH_64
```

## tests/kconfig
```kconfig
# Copyright (c) [2020] vlink Team. All rights reserved.
# SPDX-License-Identifier: MulanPSL-2.0

choice TEST_TYPE
    prompt "test configuration"
    default NOTEST

config NOTEST
    bool "no test"

config LLT
    bool "lower level test"
    rsource "llt/kconfig"

endchoice
```

## tests/llt/gtest/base/kconfig
```kconfig
# Copyright (c) [2020] vlink Team. All rights reserved.
# SPDX-License-Identifier: MulanPSL-2.0

config BASE_CASE
    bool "enable base test case"
    default n
```

## tests/llt/gtest/components/driver/kconfig
```kconfig
# Copyright (c) [2020] vlink Team. All rights reserved.
# SPDX-License-Identifier: MulanPSL-2.0

menu "driver case configuration"

config HAL_CASE
    bool "enable hal case"
    select HAL
    default n

endmenu
```

## tests/llt/gtest/components/fs/kconfig
```kconfig
# Copyright (c) [2020] vlink Team. All rights reserved.
# SPDX-License-Identifier: MulanPSL-2.0

menu "fs case configuration"

config VFS_CASE
    bool "enable vfs case"
    select MOCKFS
    default n

endmenu
```
