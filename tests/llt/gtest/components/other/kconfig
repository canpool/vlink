## tests/llt/gtest/components/other/kconfig
```kconfig
# Copyright (c) [2020] vlink Team. All rights reserved.
# SPDX-License-Identifier: MulanPSL-2.0

config CRC_CASE
    bool "enable crc case"
    select CRC8
    select CRC16
    select CRC_CCITT
    select CRC32
    select CRC64
    default n

config SECUREC_CASE
    bool "enable securec case"
    select SECUREC
    default n

config VLOG_CASE
    bool "enable vlog case"
    select VLOG
    default n

config UPRINTF_CASE
    bool "enable uprintf case"
    select UPRINTF
    default n

config VSH_CASE
    bool "enable shell case"
    select VSH
    default n
```

## tests/llt/gtest/kconfig
```kconfig
# Copyright (c) [2020] vlink Team. All rights reserved.
# SPDX-License-Identifier: MulanPSL-2.0

if GTEST

config GCOV
    def_bool y

config VALGRIND
    def_bool y

menu "test case configuration"
rsource "*/kconfig"
endmenu

endif # GTEST
```

## tests/llt/gtest/sw/kconfig
```kconfig
# Copyright (c) [2020] vlink Team. All rights reserved.
# SPDX-License-Identifier: MulanPSL-2.0

config SWQUE_CASE
    bool "enable software queue case"
    select SWQUE
    default n

config SWTMR_CASE
    bool "enable software timer case"
    select SWTMR
    default n
```

## tests/llt/kconfig
```kconfig
# Copyright (c) [2020] vlink Team. All rights reserved.
# SPDX-License-Identifier: MulanPSL-2.0

choice LLT_TYPE
    prompt "llt configuration"
    depends on LLT

config GTEST
    bool "googletest"
    rsource "gtest/kconfig"

endchoice
```

## utils/kconfig
```kconfig
# Copyright (c) [2020] vlink Team. All rights reserved.
# SPDX-License-Identifier: MulanPSL-2.0

menu "utils configuration"

config DEBUG
    bool "enable debug information"
    default y

endmenu
```
